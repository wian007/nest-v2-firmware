## meta-j49/conf/layer.conf
```bitbake
# Layer configuration for meta-j49
BBPATH .= ":${LAYERDIR}"

BBFILES += "${LAYERDIR}/recipes-*/*/*.bb \
            ${LAYERDIR}/recipes-*/*/*.bbappend"

BBFILE_COLLECTIONS += "j49"
BBFILE_PATTERN_j49 = "^${LAYERDIR}/"
BBFILE_PRIORITY_j49 = "10"

LAYERDEPENDS_j49 = "core"
LAYERSERIES_COMPAT_j49 = "blacksail"

# Our machines live in this layer
LAYERDIR_j49 = "${LAYERDIR}"
```
